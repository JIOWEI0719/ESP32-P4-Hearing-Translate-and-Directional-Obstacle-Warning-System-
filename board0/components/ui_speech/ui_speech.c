#include "ui_speech.h"
#include "audio_sr.h"
#include "esp_log.h"
#include <math.h>
#include <string.h>
#include "freertos/FreeRTOS.h"
#include "freertos/queue.h"

static const char *TAG = "ui_speech";

/* Custom 32px CJK font (generated by LVGL font converter) */
extern const lv_font_t cjk_cmd_32;

/* ====== Per-sound-source radar dot ====== */
#define MAX_RADAR_DOTS 3

typedef struct {
    lv_obj_t *dot;        /* LVGL circle object */
    int angle;            /* DOA angle 0-180, or -1 if hidden */
    int persistence;      /* remaining display cycles (0 = hidden) */
    const char *name;     /* "door_bell", "honk", or "speech" */
    lv_color_t color;     /* dot colour */
} radar_dot_t;

static radar_dot_t g_dots[MAX_RADAR_DOTS];
static lv_obj_t *g_angle_label = NULL;
static lv_obj_t *g_status_label = NULL;
static lv_obj_t *g_cmd_label   = NULL;
static lv_obj_t *g_ei_label    = NULL;

static int g_doa_angle    = -1;  /* latest DOA angle, -1 = unknown */
static int g_flash_toggle = 0;   /* flashing state */
static int g_alert_remaining = 0;

/* Arc geometry (calculated at creation) */
static int   g_arc_cx = 0;
static int   g_arc_cy = 0;
static float g_arc_r  = 0.0f;   /* outer ring radius */

static const char *get_cmd_name(int cmd_id)
{
    switch (cmd_id) {
    case 1:  return "你好";
    case 2:  return "请让一下";
    case 3:  return "小心一点";
    case 4:  return "我来帮你";
    case 5:  return "谢谢";
    default: return "";
    }
}

/* Map DOA angle to (x,y) on the outer arc.
 * DOA: 0=left(180° on visuals), 90=front(top), 180=right(0° on visuals). */
static void doa_to_arc_pos(int angle, int *x, int *y)
{
    /* LVGL arc: 180 deg = left(9h), 270 deg = top(12h), 360 deg = right(3h) */
    float rad = (float)(180 + angle) * M_PI / 180.0f;
    *x = (int)(g_arc_cx + g_arc_r * cosf(rad)) - 12;
    *y = (int)(g_arc_cy + g_arc_r * sinf(rad)) - 12;
}

/* ====== Helper: create a display-only arc ring ====== */
static lv_obj_t *create_arc_ring(lv_obj_t *parent, int radius, int width,
                                 lv_color_t color, lv_opa_t opa)
{
    lv_obj_t *arc = lv_arc_create(parent);
    int size = radius * 2 + 20;
    lv_obj_set_size(arc, size, size);
    /* Center the arc widget so its internal (cx,cy) aligns with container center */
    lv_obj_set_pos(arc, g_arc_cx - size / 2, g_arc_cy - size / 2);
    lv_obj_set_style_arc_width(arc, width, 0);
    lv_obj_set_style_arc_color(arc, color, 0);
    lv_obj_set_style_arc_opa(arc, opa, 0);
    lv_arc_set_angles(arc, 1800, 3600);
    lv_arc_set_bg_angles(arc, 1800, 3600);
    lv_obj_set_style_arc_rounded(arc, false, 0);
    lv_obj_remove_style(arc, NULL, LV_PART_KNOB);
    lv_obj_set_style_bg_opa(arc, LV_OPA_TRANSP, 0);
    /* Clear value arc (we only want the background arc visible) */
    lv_arc_set_value(arc, 0);
    lv_obj_set_style_arc_opa(arc, LV_OPA_TRANSP, LV_PART_INDICATOR);
    return arc;
}

/* ====== Helper: create a tick mark ====== */
static lv_obj_t *create_tick(lv_obj_t *parent, int angle_deg, int length,
                             lv_color_t color)
{
    lv_obj_t *tick = lv_obj_create(parent);
    lv_obj_set_size(tick, 2, length);
    lv_obj_set_style_bg_color(tick, color, 0);
    lv_obj_set_style_bg_opa(tick, LV_OPA_COVER, 0);
    lv_obj_set_style_border_width(tick, 0, 0);
    lv_obj_set_style_radius(tick, 0, 0);

    /* Place tick at outer ring radius, pointing outward */
    int r_start = (int)(g_arc_r - 2);
    float rad   = (float)(180 + angle_deg) * M_PI / 180.0f;
    int cx = g_arc_cx + (int)((r_start + length / 2.0f) * cosf(rad));
    int cy = g_arc_cy + (int)((r_start + length / 2.0f) * sinf(rad));
    lv_obj_set_pos(tick, cx - 1, cy - length / 2);

    /* Rotate tick to align with radial direction */
    lv_obj_set_style_transform_rotation(tick, angle_deg * 10, 0);

    return tick;
}

/* ====== Flashing timer: toggles opacity for all active dots ====== */
static void radar_flash_timer_cb(lv_timer_t *timer)
{
    (void)timer;
    g_flash_toggle = !g_flash_toggle;
    lv_opa_t opa = g_flash_toggle ? LV_OPA_COVER : LV_OPA_20;

    for (int i = 0; i < MAX_RADAR_DOTS; i++) {
        radar_dot_t *d = &g_dots[i];
        if (d->angle >= 0 && d->persistence > 0) {
            lv_obj_set_style_bg_opa(d->dot, opa, 0);
            lv_obj_set_style_shadow_opa(d->dot, opa == LV_OPA_COVER ? LV_OPA_80 : LV_OPA_20, 0);

            /* Reposition dot to current angle */
            int x, y;
            doa_to_arc_pos(d->angle, &x, &y);
            lv_obj_set_pos(d->dot, x, y);
        } else {
            lv_obj_add_flag(d->dot, LV_OBJ_FLAG_HIDDEN);
        }
    }
}

/* ====== UI poll timer: reads queues, updates labels, manages dot persistence ====== */
static void ui_poll_timer_cb(lv_timer_t *timer)
{
    (void)timer;

    sr_event_t sr_evt;
    while (xQueueReceive(g_sr_queue, &sr_evt, 0) == pdTRUE) {
        if (sr_evt.cmd_id == -1) {
            /* Wake word detected → listening for command */
            lv_label_set_text(g_status_label, "Listening...");
            lv_label_set_text(g_cmd_label, "聆听中......");
            if (sr_evt.doa_angle >= 0) {
                g_doa_angle = sr_evt.doa_angle;
                /* Show speech dot briefly */
                radar_dot_t *sp = &g_dots[2];  /* index 2 = speech */
                sp->angle       = sr_evt.doa_angle;
                sp->persistence = 3;
                lv_obj_clear_flag(sp->dot, LV_OBJ_FLAG_HIDDEN);
            }
        } else if (sr_evt.cmd_id == -2) {
            /* Command timeout → back to idle */
            lv_label_set_text(g_status_label, "SR Ready");
            lv_label_set_text(g_cmd_label, "请说\"Hi 乐鑫\"以激活语音识别");
        } else {
            /* Command recognized */
            lv_label_set_text(g_status_label, "Ready");
            lv_label_set_text(g_cmd_label, get_cmd_name(sr_evt.cmd_id));
            if (sr_evt.doa_angle >= 0) g_doa_angle = sr_evt.doa_angle;
        }
    }

    sr_ei_event_t ei_evt;
    while (xQueueReceive(g_ei_queue, &ei_evt, 0) == pdTRUE) {
        /* Update EI alert label */
        char buf[64];
        snprintf(buf, sizeof(buf), "ALERT: %s (%.0f%%)",
                 ei_evt.label, ei_evt.probability * 100.0f);
        lv_label_set_text(g_ei_label, buf);
        g_alert_remaining = 10;

        /* Find matching dot and set position */
        int dot_idx = -1;
        if (strcmp(ei_evt.label, "door_bell") == 0) {
            dot_idx = 0;
        } else if (strcmp(ei_evt.label, "honk") == 0) {
            dot_idx = 1;
        }

        if (dot_idx >= 0 && ei_evt.doa_angle >= 0) {
            radar_dot_t *d = &g_dots[dot_idx];
            d->angle       = ei_evt.doa_angle;
            d->persistence = 10;
            lv_obj_clear_flag(d->dot, LV_OBJ_FLAG_HIDDEN);
            /* Immediately position the dot */
            int x, y;
            doa_to_arc_pos(d->angle, &x, &y);
            lv_obj_set_pos(d->dot, x, y);
            lv_obj_set_style_bg_opa(d->dot, LV_OPA_COVER, 0);
            lv_obj_set_style_shadow_opa(d->dot, LV_OPA_80, 0);

            ESP_LOGI(TAG, "Radar dot: %s at %d deg (persistence=%d)",
                     d->name, d->angle, d->persistence);
        }
    }

    /* Update angle label */
    if (g_doa_angle >= 0) {
        char buf[16];
        snprintf(buf, sizeof(buf), "∠ %d°", g_doa_angle);
        lv_label_set_text(g_angle_label, buf);
    }

    /* Decrement dot persistence counters, hide expired */
    for (int i = 0; i < MAX_RADAR_DOTS; i++) {
        radar_dot_t *d = &g_dots[i];
        if (d->persistence > 0) {
            d->persistence--;
            if (d->persistence == 0) {
                d->angle = -1;
                lv_obj_add_flag(d->dot, LV_OBJ_FLAG_HIDDEN);
            }
        }
    }

    /* Auto-clear EI alert label */
    if (g_alert_remaining > 0) {
        g_alert_remaining--;
        if (g_alert_remaining == 0) {
            lv_label_set_text(g_ei_label, "");
        }
    }

    /* Clear command label after 8 seconds, restore placeholder */
    static int cmd_hold = 0;
    const char *text = lv_label_get_text(g_cmd_label);
    if (text[0] != '\0' && strcmp(text, "请说\"Hi 乐鑫\"以激活语音识别") != 0) {
        cmd_hold++;
        if (cmd_hold > 8) {  /* 8 seconds */
            lv_label_set_text(g_cmd_label, "请说\"Hi 乐鑫\"以激活语音识别");
            cmd_hold = 0;
        }
    } else {
        cmd_hold = 0;
    }
}

/* ========== UI Creation ========== */
lv_obj_t *ui_speech_create(lv_obj_t *parent)
{
    /* ---- Radar container (right side) ---- */
    lv_obj_t *radar_cont = lv_obj_create(parent);
    lv_obj_set_size(radar_cont, 500, 440);
    lv_obj_align(radar_cont, LV_ALIGN_TOP_RIGHT, 0, 10);
    lv_obj_set_style_bg_opa(radar_cont, LV_OPA_20, 0);
    lv_obj_set_style_bg_color(radar_cont, lv_color_hex(0x1A1A2E), 0);
    lv_obj_set_style_border_width(radar_cont, 1, 0);
    lv_obj_set_style_border_color(radar_cont, lv_color_hex(0x333355), 0);
    lv_obj_set_style_radius(radar_cont, 12, 0);

    /* Arc geometry: center at (250, 265), outer radius 210 */
    g_arc_cx = 250;
    g_arc_cy = 265;
    g_arc_r  = 210.0f;

    /* ---- 3 concentric arc rings (outer, middle, inner) ---- */
    create_arc_ring(radar_cont, 210, 2, lv_color_hex(0x333366), LV_OPA_60);  /* outer */
    create_arc_ring(radar_cont, 150, 1, lv_color_hex(0x333366), LV_OPA_40);  /* middle */
    create_arc_ring(radar_cont, 90,  1, lv_color_hex(0x333366), LV_OPA_30);  /* inner */

    /* ---- Radial tick marks every 30° ---- */
    int tick_angles[] = {0, 30, 60, 90, 120, 150, 180};
    for (int i = 0; i < 7; i++) {
        create_tick(radar_cont, tick_angles[i], 14, lv_color_hex(0x555588));
    }

    /* ---- Angle labels at 0°, 90°, 180° ---- */
    const char *mark_texts[] = {"0°", "", "", "90°", "", "", "180°"};
    int mark_angles[] = {0, 30, 60, 90, 120, 150, 180};
    for (int i = 0; i < 7; i++) {
        if (mark_texts[i][0] == '\0') continue;  /* skip unlabeled ticks */
        lv_obj_t *lbl = lv_label_create(radar_cont);
        lv_label_set_text(lbl, mark_texts[i]);
        lv_obj_set_style_text_font(lbl, &lv_font_montserrat_14, 0);
        lv_obj_set_style_text_color(lbl, lv_color_hex(0x6666AA), 0);
        /* Position label just outside outer ring + tick */
        float rad  = (float)(180 + mark_angles[i]) * M_PI / 180.0f;
        int r_label = (int)(g_arc_r + 24);
        int mx = g_arc_cx + (int)(r_label * cosf(rad));
        int my = g_arc_cy + (int)(r_label * sinf(rad));
        lv_obj_set_pos(lbl, mx - 10, my - 8);
    }

    /* ---- 3 independent flashing dots (door_bell, honk, speech) ---- */
    const char *dot_names[]   = {"door_bell", "honk", "speech"};
    lv_color_t  dot_colors[]  = {
        lv_color_hex(0xFF2222),  /* door_bell → red */
        lv_color_hex(0xFF8800),  /* honk      → orange */
        lv_color_hex(0x44CCFF),  /* speech    → cyan */
    };

    for (int i = 0; i < MAX_RADAR_DOTS; i++) {
        radar_dot_t *d = &g_dots[i];
        d->dot = lv_obj_create(radar_cont);
        lv_obj_set_size(d->dot, 24, 24);
        lv_obj_set_style_bg_color(d->dot, dot_colors[i], 0);
        lv_obj_set_style_bg_opa(d->dot, LV_OPA_COVER, 0);
        lv_obj_set_style_border_width(d->dot, 0, 0);
        lv_obj_set_style_radius(d->dot, 12, 0);
        lv_obj_set_style_shadow_width(d->dot, 14, 0);
        lv_obj_set_style_shadow_color(d->dot, dot_colors[i], 0);
        lv_obj_set_style_shadow_opa(d->dot, LV_OPA_80, 0);
        lv_obj_add_flag(d->dot, LV_OBJ_FLAG_HIDDEN);
        d->angle       = -1;
        d->persistence = 0;
        d->name        = dot_names[i];
        d->color       = dot_colors[i];
    }

    /* ---- Angle display label (below arc) ---- */
    g_angle_label = lv_label_create(radar_cont);
    lv_label_set_text(g_angle_label, "∠ --°");
    lv_obj_set_style_text_font(g_angle_label, &lv_font_montserrat_24, 0);
    lv_obj_set_style_text_color(g_angle_label, lv_color_hex(0x44CCFF), 0);
    lv_obj_align(g_angle_label, LV_ALIGN_BOTTOM_MID, 0, -30);

    /* ---- Status label (below arc) ---- */
    g_status_label = lv_label_create(radar_cont);
    lv_label_set_text(g_status_label, "SR Ready");
    lv_obj_set_style_text_font(g_status_label, &lv_font_montserrat_16, 0);
    lv_obj_set_style_text_color(g_status_label, lv_color_hex(0x8888AA), 0);
    lv_obj_align(g_status_label, LV_ALIGN_BOTTOM_MID, 0, -8);

    /* ---- Command label (bottom-left) ---- */
    g_cmd_label = lv_label_create(parent);
    lv_label_set_text(g_cmd_label, "请说\"Hi 乐鑫\"以激活语音识别");
    lv_obj_set_style_text_font(g_cmd_label, &cjk_cmd_32, 0);
    lv_obj_set_style_text_color(g_cmd_label, lv_color_hex(0x44FF44), 0);
    lv_obj_set_style_text_align(g_cmd_label, LV_TEXT_ALIGN_CENTER, 0);
    lv_obj_set_style_bg_opa(g_cmd_label, LV_OPA_40, 0);
    lv_obj_set_style_bg_color(g_cmd_label, lv_color_hex(0x000000), 0);
    lv_obj_set_style_radius(g_cmd_label, 8, 0);
    lv_obj_set_style_pad_all(g_cmd_label, 12, 0);
    lv_obj_set_width(g_cmd_label, 700);
    lv_obj_align(g_cmd_label, LV_ALIGN_BOTTOM_LEFT, 20, -20);
    lv_obj_move_foreground(g_cmd_label);

    /* ---- EI alert label (below radar arc) ---- */
    g_ei_label = lv_label_create(parent);
    lv_label_set_text(g_ei_label, "");
    lv_obj_set_style_text_font(g_ei_label, &lv_font_montserrat_16, 0);
    lv_obj_set_style_text_color(g_ei_label, lv_color_hex(0xFF6644), 0);
    lv_obj_align_to(g_ei_label, radar_cont, LV_ALIGN_OUT_BOTTOM_MID, 0, 8);

    /* Flash timer: 400 ms (toggles dot opacity) */
    lv_timer_create(radar_flash_timer_cb, 400, NULL);

    /* Poll timer: 1 Hz */
    lv_timer_create(ui_poll_timer_cb, 1000, NULL);

    ESP_LOGI(TAG, "Speech UI (radar) created");
    return radar_cont;
}
