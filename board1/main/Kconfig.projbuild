## board1/main/Kconfig.projbuild
```kconfig
menu "Camera Configuration"

    config EXAMPLE_MIPI_CSI_SCCB_I2C_PORT
        int "MIPI CSI SCCB I2C Port Number"
        default 0
        range 0 1

    config EXAMPLE_MIPI_CSI_SCCB_I2C_SCL_PIN
        int "MIPI CSI SCCB I2C SCL Pin"
        default 8
        range -1 56

    config EXAMPLE_MIPI_CSI_SCCB_I2C_SDA_PIN
        int "MIPI CSI SCCB I2C SDA Pin"
        default 7
        range -1 56

    config EXAMPLE_MIPI_CSI_SCCB_I2C_FREQ
        int "MIPI CSI SCCB I2C Frequency"
        default 100000
        range 100000 400000

    config EXAMPLE_MIPI_CSI_CAM_SENSOR_RESET_PIN
        int "MIPI CSI Camera Sensor Reset Pin"
        default -1
        range -1 56

    config EXAMPLE_MIPI_CSI_CAM_SENSOR_PWDN_PIN
        int "MIPI CSI Camera Sensor Power Down Pin"
        default -1
        range -1 56

    config EXAMPLE_H264_I_PERIOD
        int "H.264 Intra Frame period"
        default 30
        range 1 120

    config EXAMPLE_H264_BITRATE
        int "H.264 Bitrate"
        default 1000000
        range 25000 2500000

    config EXAMPLE_H264_MIN_QP
        int "H.264 Minimum Quality"
        default 25
        range 1 51

    config EXAMPLE_H264_MAX_QP
        int "H.264 Maximum Quality"
        default 26
        range 1 51

endmenu
```

## board1/sdkconfig.defaults
```kconfig
CONFIG_IDF_TARGET="esp32p4"
CONFIG_ESPTOOLPY_FLASHMODE_QIO=y
CONFIG_ESPTOOLPY_FLASHSIZE_16MB=y
CONFIG_PARTITION_TABLE_CUSTOM=y
CONFIG_PARTITION_TABLE_CUSTOM_FILENAME="partitions.csv"
CONFIG_PARTITION_TABLE_FILENAME="partitions.csv"
CONFIG_SPIRAM=y
CONFIG_IDF_EXPERIMENTAL_FEATURES=y
CONFIG_SPIRAM_SPEED_200M=y
CONFIG_LWIP_TCPIP_RECVMBOX_SIZE=64
CONFIG_LWIP_TCP_SND_BUF_DEFAULT=65535
CONFIG_LWIP_TCP_WND_DEFAULT=65535
CONFIG_LWIP_TCP_RECVMBOX_SIZE=64
CONFIG_LWIP_MAX_SOCKETS=16
CONFIG_FREERTOS_HZ=1000
CONFIG_FREERTOS_PLACE_FUNCTIONS_INTO_FLASH=y
CONFIG_ESP_VIDEO_ENABLE_DVP_VIDEO_DEVICE=n
CONFIG_ESP_VIDEO_ENABLE_ISP_PIPELINE_CONTROLLER=y
CONFIG_ESP_VIDEO_ENABLE_HW_H264_VIDEO_DEVICE=y
CONFIG_EXAMPLE_CONNECT_WIFI=n
CONFIG_EXAMPLE_CONNECT_ETHERNET=y
```

## board1/sdkconfig.defaults.ov5647
```kconfig
CONFIG_CAMERA_OV5647=y
CONFIG_CAMERA_OV5647_AUTO_DETECT_MIPI_INTERFACE_SENSOR=y
CONFIG_CAMERA_OV5647_MIPI_RAW8_800X800_50FPS=y
CONFIG_CAMERA_OV5647_MIPI_IF_FORMAT_INDEX_DEFAULT=2
CONFIG_CAMERA_OV5647_CSI_LINESYNC_ENABLE=y
CONFIG_CAMERA_OV5647_DEFAULT_IPA_JSON_CONFIGURATION_FILE=y
```
